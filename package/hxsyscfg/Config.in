## package/hxsyscfg/Config.in
```kconfig
config BR2_PACKAGE_HXSYSCFG
	bool "hxsyscfg"
	depends on BR2_TOOLCHAIN_HAS_THREADS
	depends on BR2_USE_MMU # fork()
	help
	  HX SysCFG

	  https://corellium.com
```

## package/hxutils/Config.in
```kconfig
config BR2_PACKAGE_HXUTILS
	bool "hxutils"
	depends on BR2_TOOLCHAIN_HAS_THREADS
	depends on BR2_USE_MMU # fork()
	help
	  HX Utils

	  https://projectsandcastle.org
```
